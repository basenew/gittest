## atris3/MCU/chassis_controller/APP/chassis/Kconfig
```kconfig
menu "CHASSIS Configuration"


config PKG_USING_CHASSIS
    bool "Use CHASSIS support"
    default n

endmenu
```

## atris3/MCU/monitor/APP/Kconfig
```kconfig
mainmenu "RT-Thread Configuration"

config BSP_DIR
    string
    option env="BSP_ROOT"
    default "."

config RTT_DIR
    string
    option env="RTT_ROOT"
    default "../../rt-thread-master"

config PKGS_DIR
    string
    option env="PKGS_ROOT"
    default "packages"


source "$RTT_DIR/Kconfig"
source "$PKGS_DIR/Kconfig"
source "../../libraries/Kconfig"
source "applications/Kconfig"
source "board/Kconfig"
```

## atris3/MCU/monitor/APP/applications/Kconfig
```kconfig
menu "applications Configuration"


config PKG_USING_FOTA
    bool "Use ota support"
    default n

config PKG_USING_LOG
    bool "Use log support"
    default n

config PKG_USING_SW_CHECK
    bool "Use switch check module"
    select RT_USING_PIN
    default n
	
config PKG_USING_HSUCHM_01A
    bool "Use huschm_01 moudles"
    default n
    if PKG_USING_HSUCHM_01A
    config PKG_USING_HSUCHM_01A_TEMP
		bool "Use huschm_01 temperature"
        default n
    config PKG_USING_HSUCHM_01A_HUMI
		bool "Use huschm_01 humidity"
        default n
    endif

endmenu
```

## atris3/MCU/monitor/APP/applications/sw_check/Kconfig
```kconfig
menuconfig PKG_USING_SW_CHECK
    bool "Use switch check module"
    default n
    select RT_USING_PIN
    
```

## atris3/MCU/motor_controller/APP/applications/Kconfig
```kconfig
menu "applications Configuration"


config PKG_USING_FOTA
    bool "Use ota support"
    default n

config PKG_USING_LOG
    bool "Use log support"
    default n

config PKG_USING_SW_CHECK
    bool "Use switch check module"
    select RT_USING_PIN
    default n

endmenu
```

## atris3/MCU/motor_controller/APP/motor/Kconfig
```kconfig
menu "Motor Configuration"


config PKG_USING_MOTOR
    bool "Use MOTOR support"
    default n

endmenu
```

## atris3/MCU/motor_controller/APP/packages/rtc_pcf8563/Kconfig
```kconfig
menuconfig PKG_USING_RTC_PCF8563
    bool "Use onboard rtc chip named pcf8563"
    default n
    select RT_USING_I2C
    if PKG_USING_RTC_PCF8563
        config RTC_USING_I2CBUS_NAME
        string "config the i2c bus name"
        default "i2c1"
    endif
```
